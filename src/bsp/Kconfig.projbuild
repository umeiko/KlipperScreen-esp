## src/bsp/Kconfig.projbuild
```kconfig
menu "Board selection"

    choice BOARD
        prompt "Target board"
        default BOARD_CYD_2432S028R
        help
            选择要构建的固件产物（板型）。不同板型芯片不同（ESP32 / ESP32-S3），
            还需配合对应的 sdkconfig（构建脚本 tools/build-esp32.sh 会自动处理）。

        config BOARD_CYD_2432S028R
            bool "CYD 2432S028R (ESP32, 320x240 ILI9341 + XPT2046)"

        config BOARD_CYD_2432S028R_PLUS
            bool "CYD 2432S028R-PLUS (ESP32, 320x240 ST7789 + XPT2046)"

        config BOARD_E32R35T
            bool "ESP32-32E E32R35T (ESP32, 480x320 ST7796 + XPT2046)"

        config BOARD_JC8048W550
            bool "JC8048W550 (ESP32-S3, 800x480 ST7262 RGB + GT911)"

        config BOARD_SENSECAP_INDICATOR
            bool "Seeed SenseCAP Indicator (ESP32-S3, 480x480 ST7701S RGB + FT5x06)"

        config BOARD_ESP32S3_4848S040
            bool "Guition ESP32-4848S040 (ESP32-S3, 480x480 ST7701S RGB + GT911)"

        config BOARD_ESP32S3_JLC_SZP
            bool "立创实战派 ESP32-S3 (ESP32-S3 N16R8, 2.0\" 320x240 ST7789 + FT6336)"

        config BOARD_EC11_KNOB_MINIMAL
            bool "esp32s3-st7789-320_240-ec11 (ESP32-S3 + 240x320 ST7789 + EC11)"

        config BOARD_EC11_KNOB_ESP32
            bool "esp32-st7735s-128_160-ec11 (ESP32 + 1.8\" 128x160 ST7735S + EC11, 引脚对齐 CYD)"

        config BOARD_EC11_KNOB_ESP32_ST7789
            bool "esp32-st7789-320_240-ec11 (ESP32 + 240x320 ST7789 + EC11, 引脚对齐 CYD)"

        config BOARD_ESP32_ILI9341_EC11
            bool "esp32-ILI9341-320_240-ec11 (ESP32 + 240x320 ILI9341 + EC11, 引脚对齐 CYD)"

        config BOARD_ESP32_ST7796_EC11
            bool "esp32-ST7796-320_240-ec11 (ESP32 + 240x320 ST7796 + EC11, 引脚对齐 CYD)"

        config BOARD_ESP32S3_ST7796_EC11
            bool "esp32s3-st7796-480_320-xpt2046-ec11 (ESP32-S3 + 480x320 ST7796S + XPT2046 + EC11)"

        config BOARD_ESP32S3_ILI9488_EC11
            bool "esp32s3-ILI9488-480_320-xpt2046-ec11 (ESP32-S3 + 480x320 ILI9488 + XPT2046 + EC11)"

        config BOARD_ESP32S3_ILI9341_EC11
            bool "esp32s3-ILI9341-320_240-xpt2046-ec11 (ESP32-S3 + 320x240 ILI9341 + XPT2046 + EC11)"

        config BOARD_ESP32S3_RETRO_GO
            bool "esp32s3-retro-go (Chaeng retro-go ESP32-S3 掌机, 3.2\" 320x240 ST7789 + GPIO 按键)"

        config BOARD_ESP32C3_ST7789_EC11
            bool "esp32c3-st7789-320_240-ec11 (ESP32-C3 + 240x320 ST7789 + EC11, 合宙 CORE/Super Mini)"
    endchoice

endmenu

menu "Optional input devices"

    config INPUT_ROTARY_ENCODER
        bool "Enable an external rotary encoder"
        default n
        help
            Add a quadrature rotary encoder as a second LVGL input device.
            It can be used together with a board's existing touch controller.

    config INPUT_ROTARY_GPIO_A
        int "Encoder A GPIO"
        range 0 48
        default 4
        depends on INPUT_ROTARY_ENCODER

    config INPUT_ROTARY_GPIO_B
        int "Encoder B GPIO"
        range 0 48
        default 5
        depends on INPUT_ROTARY_ENCODER

    config INPUT_ROTARY_GPIO_BUTTON
        int "Encoder push-button GPIO"
        range 0 48
        default 6
        depends on INPUT_ROTARY_ENCODER

    config INPUT_ROTARY_COUNTS_PER_DETENT
        int "Quadrature counts per detent"
        range 1 8
        default 4
        depends on INPUT_ROTARY_ENCODER
        help
            Most full-step EC11 encoders produce four PCNT counts per click.
            Use 2 or 1 if several physical clicks are needed for one UI item.
            Increase the value if one physical click skips multiple UI items.
            Encoder-equipped firmware also allows a confirmed runtime override
            under Settings -> Display -> Encoder step.

    config INPUT_ROTARY_PHASE_PULLUPS
        bool "Enable internal pull-ups on encoder A/B"
        default y
        depends on INPUT_ROTARY_ENCODER
        help
            Keep this enabled for a bare mechanical encoder wired to GND.
            Disable it when the encoder module already provides phase pull-ups
            or when the selected GPIOs require external resistors.

    config INPUT_ROTARY_REVERSE
        bool "Reverse rotation direction"
        default n
        depends on INPUT_ROTARY_ENCODER

    config INPUT_ROTARY_BUTTON_ACTIVE_LOW
        bool "Push button is active-low"
        default y
        depends on INPUT_ROTARY_ENCODER
        help
            Active-low enables the GPIO's internal pull-up. Wire the button
            between the configured GPIO and GND.

    config INPUT_ROTARY_BUTTON_DEBOUNCE_MS
        int "Push button debounce (ms)"
        range 0 200
        default 20
        depends on INPUT_ROTARY_ENCODER

    config INPUT_ROTARY_GLITCH_FILTER_NS
        int "Quadrature glitch filter (ns)"
        range 0 10000
        default 1000
        depends on INPUT_ROTARY_ENCODER
        help
            Pulses shorter than this are ignored by the PCNT peripheral.
            Set to 0 to disable the hardware filter.

endmenu
```
